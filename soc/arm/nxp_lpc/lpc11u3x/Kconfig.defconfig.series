## soc/arm/nxp_lpc/lpc11u3x/Kconfig.defconfig.series
```kconfig
# LPC11U3X series configuration options

# Copyright (c) 2020, Seagate
# SPDX-License-Identifier: Apache-2.0

if SOC_SERIES_LPC11U3X

source "soc/arm/nxp_lpc/lpc11u3x/Kconfig.defconfig.lp*"

config SOC_SERIES
	default "lpc11u3x"

config NUM_IRQS
	# must be >= the highest interrupt number used
	default 40

endif # SOC_SERIES_LPC11U3X
```

## soc/arm/nxp_lpc/lpc11u3x/Kconfig.series
```kconfig
# LPC LPC11U3X MCU line

# Copyright (c) 2020, Seagate
# SPDX-License-Identifier: Apache-2.0

config SOC_SERIES_LPC11U3X
	bool "LPC LPC11U3X Series MCU"
	select ARM
	select CPU_CORTEX_M0
	select CPU_CORTEX_M_HAS_SYSTICK
	select SOC_FAMILY_LPC
	select PINCTRL
	select CLOCK_CONTROL
	help
	  Enable support for LPC LPC11U3X MCU series
```

## soc/arm/nxp_lpc/lpc11u3x/Kconfig.soc
```kconfig
# LPC LPC11U3x MCU line

# Copyright (c) 2020, Seagate
# SPDX-License-Identifier: Apache-2.0

choice
	prompt "LPC LPC11U3X MCU Selection"
	depends on SOC_SERIES_LPC11U3X

config SOC_LPC11U37
	bool "SOC_LPC11U37"

endchoice

if SOC_SERIES_LPC11U3X

config SOC_PART_NUMBER_LPC11U37FBD64
	bool

config SOC_PART_NUMBER_LPC11U3X
	string
	default "LPC11U37FBD64" if SOC_PART_NUMBER_LPC11U37FBD64

	help
	  This string holds the full part number of the SoC. It is a hidden
	  option that you should not set directly. The part number selection
	  choice defines the default value for this string.
endif # SOC_SERIES_LPC11U3X
```
